## CMakeLists.txt
```
#
# Copyright (c) 2017 Linaro Limited
#
# SPDX-License-Identifier: Apache-2.0
#

cmake_minimum_required(VERSION 3.13.1)
find_package(Zephyr REQUIRED HINTS $ENV{ZEPHYR_BASE})
project(MQTT_GNSS2)

target_sources(app PRIVATE src/mqtt_connection.c)
target_sources(app PRIVATE src/main.c)
```

## Kconfig
```
#
# Copyright (c) 2020 Nordic Semiconductor ASA
#
# SPDX-License-Identifier: LicenseRef-Nordic-5-Clause
#

menu "Cellfund Lesson 4 Exercise"

config MQTT_PUB_TOPIC
	string "MQTT publish topic"
	default "devacademy/publish/topic"

config MQTT_SUB_TOPIC
	string "MQTT subscribe topic"
	default "devacademy/subscribe/topic"

config MQTT_CLIENT_ID
	string "MQTT Client ID"
	help
	  Use a custom Client ID string. If not set, the client ID will be
	  generated based on IMEI number (for nRF91 Series based targets) or
	  randomly (for other platforms).
	default ""

config MQTT_BROKER_HOSTNAME
	string "MQTT broker hostname"
	default "mqtt.nordicsemi.academy"

config MQTT_BROKER_PORT
	int "MQTT broker port"
	default 1883

config MQTT_MESSAGE_BUFFER_SIZE
	int "MQTT message buffer size"
	default 128

config MQTT_PAYLOAD_BUFFER_SIZE
	int "MQTT payload buffer size"
	default 128

config BUTTON_EVENT_PUBLISH_MSG
	string "The message to publish on a button event"
	default "Hi from nRF91 Series device"

config TURN_LED_ON_CMD
	string "Command to turn on LED"
	default "LED1ON"

config TURN_LED_OFF_CMD
	string "Command to turn off LED"
	default "LED1OFF"

config BUTTON_EVENT_BTN_NUM
	int "The button number"
	default 1

config MQTT_RECONNECT_DELAY_S
	int "Seconds to delay before attempting to reconnect to the broker."
	default 60

config MQTT_TLS_SEC_TAG
	int "TLS credentials security tag"
	default 24

config MQTT_TLS_SESSION_CACHING
	bool "Enable TLS session caching"

config MQTT_TLS_PEER_VERIFY
	int "Set peer verification level"
	default 2
	help
		Set to 0 for VERIFY_NONE, 1 for VERIFY_OPTIONAL, and 2 for
		VERIFY_REQUIRED.

config MQTT_USERNAME
	string "MQTT Broker username"
	default "User Name"

config MQTT_PASSWORD
	string "MQTT Broker password"
	default "PWD"

config GNSS_INTERVAL
	int "Interval for periodic GNSS search"
	default 20
	help
		Search interval (in minutes) for GNSS search

config GNSS_TIMEOUT
	int "Timeout for GNSS search"
	range 60000 600000
	default 300000
	help
	  GNSS search timeout (in miliseconds)  	   

config GNSS_PERIODIC_INTERVAL
	int "Fix interval for periodic fixes"
	range 10 65535
	default 120
	help
		Fix interval (in seconds) for periodic fixes

config GNSS_PERIODIC_TIMEOUT
	int "Fix timeout for periodic GPS fixes"
	range 0 65535
	default 480
	help
		Fix timeout (in seconds) for periodic fixes
		If set zero, GNSS is allowed to run idefinitely until a valid PVT estimate is produced


endmenu

source "Kconfig.zephyr"
```

## prj.conf
```kconfig
#
# Copyright (c) 2017 Linaro Limited
#
# SPDX-License-Identifier: Apache-2.0
#

CONFIG_BOOTLOADER_MCUBOOT=y

CONFIG_PRINTK=y
CONFIG_LOG=y

CONFIG_DK_LIBRARY=y

CONFIG_NEWLIB_LIBC=y

CONFIG_NEWLIB_LIBC_FLOAT_PRINTF=y
CONFIG_FPU=y

CONFIG_NETWORKING=y
CONFIG_NET_NATIVE=n
CONFIG_NET_SOCKETS=y
CONFIG_NET_SOCKETS_OFFLOAD=y
CONFIG_POSIX_API=y

CONFIG_HEAP_MEM_POOL_SIZE=4096
CONFIG_MAIN_STACK_SIZE=4096

CONFIG_NRF_MODEM_LIB=y

CONFIG_MODEM_KEY_MGMT=y

CONFIG_LTE_LINK_CONTROL=y
# STEP 2.1 - Enable modem GPS mode
CONFIG_LTE_NETWORK_MODE_LTE_M_NBIOT_GPS=y

CONFIG_MQTT_LIB=y
CONFIG_MQTT_CLEAN_SESSION=y
CONFIG_MQTT_LIB_TLS=y

# Application
CONFIG_MQTT_PUB_TOPIC="nrf-F98C/GNSS"
CONFIG_BUTTON_EVENT_PUBLISH_MSG="Hi from thr nRF91 Series device (doboK)"
CONFIG_MQTT_BROKER_HOSTNAME="hivemq.eu.hivemq.cloud"
# STEP 2.2 - Change the MQTT broker port
CONFIG_MQTT_BROKER_PORT=8883

#CONFIG_AT_HOST_LIBRARY=n
#CONFIG_UART_INTERRUPT_DRIVEN=y
```

## src/main.c
```c
/*
 * Copyright (c) 2017 Linaro Limited
 *
 * SPDX-License-Identifier: Apache-2.0
 */

#include <string.h>
#include <stdio.h>
#include <zephyr/kernel.h>
#include <zephyr/sys/printk.h>
#include <zephyr/logging/log.h>

#include <modem/nrf_modem_lib.h>
#include <modem/lte_lc.h>
#include <dk_buttons_and_leds.h>
#include <zephyr/net/socket.h>

#include <nrf_modem_gnss.h>
#include <zephyr/net/socket.h>
#include <zephyr/net/mqtt.h>


#include "mqtt_connection.h"

#define MESSAGE_SIZE				256

#define STACK_SIZE					1024
#define GNSS_THREAD_PRIORITY		5
#define	KEEP_ALIVE_THREAD_PRIORITY	7
#define SEND_MQTT_THREAD_PRIORITY	6


LOG_MODULE_REGISTER(MQTT_GNSS, LOG_LEVEL_INF);

K_SEM_DEFINE(GNSS_SEM, 0, 1);
K_SEM_DEFINE(SEND_MQTT_SEM, 0, 1);

K_SEM_DEFINE(lte_connected, 0, 1);

K_THREAD_STACK_DEFINE(threadStackGNSS, STACK_SIZE);
K_THREAD_STACK_DEFINE(threadStackMQTT, STACK_SIZE);

K_MSGQ_DEFINE(gnssMessage, sizeof(bool), 2, 1);
K_MSGQ_DEFINE(LTE_Message, sizeof(bool), 2, 1);
K_MSGQ_DEFINE(LTE_error, sizeof(bool), 2, 1);
K_MSGQ_DEFINE(getGnss, sizeof(bool), 2, 1);

struct k_thread gnssThreadData, keepAliveThreadData, sendMQTT_ThreadData;

static struct nrf_modem_gnss_pvt_data_frame	pvtData;

static uint8_t GPS_data[MESSAGE_SIZE];

static struct mqtt_client client;

static struct pollfd fds;

static bool fixFind = false;
static bool lteConnected = false;
static bool lteError = false;
volatile bool connected = false;

static void lte_handler(const struct lte_lc_evt *const evt)
{
	switch(evt->type)
	{
		case LTE_LC_EVT_NW_REG_STATUS:
			if((evt->nw_reg_status != LTE_LC_NW_REG_REGISTERED_HOME) &&
			   (evt->nw_reg_status != LTE_LC_NW_REG_REGISTERED_ROAMING))
			{
				break;
			}

			if(evt->nw_reg_status == LTE_LC_NW_REG_REGISTRATION_DENIED)
			{
				LOG_ERR("LTE error");
				lteError = true;
				k_msgq_put(&LTE_error, &lteError, K_FOREVER);
				lteError = false;
				k_sem_give(&lte_connected);
				break;
			}

			LOG_INF("Networking registration status: %s", 
				evt->nw_reg_status == LTE_LC_NW_REG_REGISTERED_HOME ? "Connected - home network" : "Connected - Roaming");
			lteConnected = true;
			k_msgq_put(&LTE_Message, &lteConnected, K_FOREVER);
			lteConnected = false;
			k_sem_give(&lte_connected);
			break;

		case LTE_LC_EVT_RRC_UPDATE:
			LOG_INF("RRC mode: %s", evt->rrc_mode == LTE_LC_RRC_MODE_CONNECTED ? "Connected" : "Idle");
			break;

		case LTE_LC_EVT_CELL_UPDATE:
			LOG_INF("LTE cell changed: Cell ID: %d, Tracking area: %d\n", evt->cell.id, evt->cell.tac);
			break;
		
		default:
			break;
	}
}

static int modem_configure(void)
{
	int err;

	printk("Initializing modme library");

	err = nrf_modem_lib_init();
	if(err)
	{
		LOG_ERR("Failed to initialize the modem library: error: %d", err);
		return err;
	}

	err = certificate_provision();
	if(err != 0)
	{
		LOG_ERR("Failed to provision certificates");
		return err;
	}

	LOG_INF("Connecting to LTE network");
	err = lte_lc_connect_async(lte_handler);
	if(err)
	{
		LOG_ERR("Error in lte_lc_connect_async, error: %d", err);
		return err;
	}

	return 0;
}

static void printFixData(struct nrf_modem_gnss_pvt_data_frame *pvt_data)
{
	LOG_INF("Latitude:			%.06f", pvt_data->latitude);
	LOG_INF("Longitude:			%.06f", pvt_data->longitude);
	LOG_INF("Altitude:			%.01f m", (double)pvt_data->altitude);
	LOG_INF("Time (UTC): 		%02u:%02u:%02u.%03u", pvt_data->datetime.hour,
								pvt_data->datetime.minute,
								pvt_data->datetime.seconds,
								pvt_data->datetime.ms);

	int err = snprintf(GPS_data, MESSAGE_SIZE, "Time (UTC): %02u:%02u:%02u, Latitude: %.06f, Longitude: %.06f", pvt_data->datetime.hour,  pvt_data->datetime.minute, 
																										        pvt_data->datetime.seconds, pvt_data->latitude, pvt_data->longitude);
	if(err < 0)
	{
		LOG_ERR("Failed to print to buffer: %d", err);
	}
}

static void gnss_event_handler(int event)
{
	int err;
	static bool toggle = false;
	switch(event)
	{
		case NRF_MODEM_GNSS_EVT_PVT:
			err = nrf_modem_gnss_read(&pvtData, sizeof(pvtData), NRF_MODEM_GNSS_DATA_PVT);
			fixFind = false;
			dk_set_led_off(DK_LED1);
			if(toggle)
			{
				dk_set_led_on(DK_LED3);
			}
			else
			{
				dk_set_led_off(DK_LED3);
			}

			toggle = !toggle;
			
			if(err)
			{
				dk_set_led_off(DK_LED3);
				LOG_ERR("nrf_modem_gnss_read failed, err %d", err);
				return;
			}

			if(pvtData.flags & NRF_MODEM_GNSS_PVT_FLAG_FIX_VALID)
			{
				dk_set_led_off(DK_LED3);
				fixFind = true;
				k_msgq_put(&gnssMessage, &fixFind, K_FOREVER);
			}

			break;

		case NRF_MODEM_GNSS_EVT_PERIODIC_WAKEUP:
			LOG_INF("GNSS has woken up");
			break;
		
		case NRF_MODEM_GNSS_EVT_SLEEP_AFTER_FIX:
			LOG_INF("GNSS enters sleep after fix");
			break;

		default:
			break;
	}
}

void gnssThread(void *arg1, void *arg2, void *arg3)
{
	bool firstStart = true;
	bool gnnsFixGet = false;
	bool getNewGnss = false;
	

	uint64_t startTime = 0;
	int err;

	while(1)
	{
		k_sem_take(&GNSS_SEM, K_FOREVER);

		getNewGnss = false;

		err = lte_lc_func_mode_set(LTE_LC_FUNC_MODE_ACTIVATE_GNSS);
		if(err)
		{
			LOG_ERR("Failed to deactivate LTE and enable GNSS functional mode");
		}

		//dk_set_led_on(DK_LED2);
		printk("Starting GNSS");
		if(nrf_modem_gnss_start() != 0)
		{
			LOG_ERR("Failed to start GNSS");
		}

		startTime = k_uptime_get();
		
		printk("GNSS search\r\n");
		

		while(!gnnsFixGet)
		{
			k_msgq_get(&gnssMessage, &gnnsFixGet, K_NO_WAIT);
			//if(!firstStart)
			//{
				if(k_uptime_get() - startTime >= CONFIG_GNSS_TIMEOUT)
				{
					firstStart = false;
					LOG_ERR("GNSS not find in time");
					LOG_INF("Stop GNSS");
					err = nrf_modem_gnss_stop();
					dk_set_led_off(DK_LED3);
					if(err)
					{
						LOG_ERR("nrf_modem_gnss_stop_error, err %d", err);
					}
					snprintf(GPS_data, MESSAGE_SIZE, "Time out GNSS");
					break;
				}
			//}
			
		}

		LOG_INF("Find time: %lld s\r\n", (k_uptime_get() - startTime)/1000);

		gnnsFixGet = false;
		firstStart = false;

		getNewGnss = true;

		err = lte_lc_func_mode_set(LTE_LC_FUNC_MODE_OFFLINE);
		if(err)
		{
			LOG_ERR("Failed to deactivate LTE and enable GNSS functional mode");
		}

		k_msgq_put(&getGnss, &getNewGnss, K_FOREVER);

		

		k_yield();
		
	}
}

void sendMQTT_Thread(void *arg1, void *arg2, void *arg3)
{
	int err;
	bool lteConnectedGet = false;
	uint8_t counter = 0;
	bool getNewGnss = false;
	bool getLteError = false;
	
	while(1)
	{
		k_sleep(K_SECONDS(60));
		k_msgq_get(&getGnss, &getNewGnss, K_NO_WAIT);
		LOG_INF("get gnss: %d", getNewGnss);
		LOG_INF("Counter: %d", counter);
		
		if(getNewGnss)
		{
			getNewGnss = false;
			err = lte_lc_func_mode_set(LTE_LC_FUNC_MODE_NORMAL);
			if (err != 0){
				LOG_ERR("Failed to activate LTE");
				//break;
			}

			dk_set_led_on(DK_LED1); //piros led
			k_sem_take(&lte_connected, K_FOREVER);
			dk_set_led_off(DK_LED1);

			dk_set_led_on(DK_LED2); //kék led
			while(!lteConnectedGet)
			{
				k_msgq_get(&LTE_Message, &lteConnectedGet, K_NO_WAIT);
			}
			dk_set_led_off(DK_LED2);
			lteConnectedGet = false;

			printFixData(&pvtData);

			k_msgq_get(&LTE_error, &getLteError, K_NO_WAIT);

			if(!getLteError)
			{

				err = mqtt_live(&client);

				if(err)
				{
					LOG_ERR("MQTT disconnected, err %d", err);

					err = client_init(&client);
					if (err) {
						LOG_ERR("Failed to initialize MQTT client: %d", err);
					}

					err = mqtt_connect(&client);
					if(err)
					{
						LOG_ERR("Error in mqtt_connect: %d", err);
						//return;
					}

					while (!connected) {
						LOG_INF("Wait for mqtt connect");
						mqtt_input(&client);  // feldolgozza az érkező MQTT csomagokat
						mqtt_live(&client);   // életjel küldés, ha kell
						k_sleep(K_MSEC(100)); // kis szünet, hogy ne pörögjön a ciklus
					}
					connected = false;
				}
			
				err = fds_init(&client, &fds);
				if(err)
				{
					LOG_ERR("Error in fds_init: %d", err);
					//return;
				}

				

				LOG_INF("SEND data to server!\r\n");
				
				data_publish(&client, MQTT_QOS_1_AT_LEAST_ONCE, GPS_data, sizeof(GPS_data));
				if(err)
				{
					LOG_ERR("Error in data_publish, err %d", err);
				}

				/*err = mqtt_disconnect(&client);
				if(err)
				{
					LOG_ERR("error in mqtt_disconnect, err %d", err);
				}*/
			}

			err = lte_lc_func_mode_set(LTE_LC_FUNC_MODE_OFFLINE);
			if(err)
			{
				LOG_ERR("Failed to deactivate LTE and enable GNSS functional mode");
			}

		}
		else
		{
			counter++;

			if(counter == CONFIG_GNSS_INTERVAL)
			{
				counter = 0;
				k_sem_give(&GNSS_SEM);
				k_yield();
			}
		}
	}
}


int main(void)
{
	int err;
	uint32_t connect_attempt = 0;

	k_tid_t threadID0, threadID2;

	if(dk_leds_init() != 0)
	{
		LOG_ERR("Failed to initialize the LEDS Library");
	}

	err = modem_configure();
	if(err)
	{
		LOG_ERR("Failed to configure the modem");
		return 0;
	}

	k_sem_take(&lte_connected, K_FOREVER);

	err = client_init(&client);
	if (err) {
		LOG_ERR("Failed to initialize MQTT client: %d", err);
		return 0;
	}

	if (connect_attempt++ > 0) {
		LOG_INF("Reconnecting in %d seconds...",
			CONFIG_MQTT_RECONNECT_DELAY_S);
		k_sleep(K_SECONDS(CONFIG_MQTT_RECONNECT_DELAY_S));
	}

	err = mqtt_connect(&client);
	if(err)
	{
		LOG_ERR("Error in mqtt_connect: %d", err);
	}

	while (!connected) {
		mqtt_input(&client);  // feldolgozza az érkező MQTT csomagokat
		mqtt_live(&client);   // életjel küldés, ha kell
		k_sleep(K_MSEC(100)); // kis szünet, hogy ne pörögjön a ciklus
	}
	connected = false;

	

	err = fds_init(&client,&fds);
	if (err) {
		LOG_ERR("Error in fds_init: %d", err);
		return 0;
	}

	err = data_publish(&client, MQTT_QOS_1_AT_LEAST_ONCE, (uint8_t *)"Hello", sizeof("Hello"));
	if(err)
	{
		LOG_ERR("Error in data_publish, err %d", err);
	}

	/*err = mqtt_disconnect(&client);
	if(err)
	{
		LOG_ERR("error in mqtt_disconnect, err %d", err);
		return err;
	}*/


	
	if(lte_lc_func_mode_set(LTE_LC_FUNC_MODE_ACTIVATE_GNSS) != 0)
	{
		LOG_ERR("Failed to activate GNSS functional mode");
	}

	if(nrf_modem_gnss_event_handler_set(gnss_event_handler) != 0)
	{
		LOG_ERR("Failed to set GNSS event handler");
		return 0;
	}

	

	if(lte_lc_func_mode_set(LTE_LC_FUNC_MODE_OFFLINE) != 0)
	{
		LOG_ERR("Failed to activate GNSS functional mode");
	}



	printk("Init threads\r\n");

	k_sem_give(&GNSS_SEM);

	threadID0 = k_thread_create(&gnssThreadData, threadStackGNSS, K_THREAD_STACK_SIZEOF(threadStackGNSS), gnssThread, (void *)fixFind, NULL, NULL, GNSS_THREAD_PRIORITY, 0, K_NO_WAIT);
	threadID2 = k_thread_create(&sendMQTT_ThreadData, threadStackMQTT, K_THREAD_STACK_SIZEOF(threadStackMQTT), sendMQTT_Thread, NULL, NULL, NULL, SEND_MQTT_THREAD_PRIORITY, 0, K_NO_WAIT);
	
}
```

## src/certificate.h
```c
#define CA_CERTIFICATE \
"-----BEGIN CERTIFICATE-----\n" \
"MIIFazCCA1OgAwIBAgIRAIIQz7DSQONZRGPgu2OCiwAwDQYJKoZIhvcNAQELBQAw\n" \
"TzELMAkGA1UEBhMCVVMxKTAnBgNVBAoTIEludGVybmV0IFNlY3VyaXR5IFJlc2Vh\n" \
"cmNoIEdyb3VwMRUwEwYDVQQDEwxJU1JHIFJvb3QgWDEwHhcNMTUwNjA0MTEwNDM4\n" \
"WhcNMzUwNjA0MTEwNDM4WjBPMQswCQYDVQQGEwJVUzEpMCcGA1UEChMgSW50ZXJu\n" \
"ZXQgU2VjdXJpdHkgUmVzZWFyY2ggR3JvdXAxFTATBgNVBAMTDElTUkcgUm9vdCBY\n" \
"MTCCAiIwDQYJKoZIhvcNAQEBBQADggIPADCCAgoCggIBAK3oJHP0FDfzm54rVygc\n" \
"h77ct984kIxuPOZXoHj3dcKi/vVqbvYATyjb3miGbESTtrFj/RQSa78f0uoxmyF+\n" \
"0TM8ukj13Xnfs7j/EvEhmkvBioZxaUpmZmyPfjxwv60pIgbz5MDmgK7iS4+3mX6U\n" \
"A5/TR5d8mUgjU+g4rk8Kb4Mu0UlXjIB0ttov0DiNewNwIRt18jA8+o+u3dpjq+sW\n" \
"T8KOEUt+zwvo/7V3LvSye0rgTBIlDHCNAymg4VMk7BPZ7hm/ELNKjD+Jo2FR3qyH\n" \
"B5T0Y3HsLuJvW5iB4YlcNHlsdu87kGJ55tukmi8mxdAQ4Q7e2RCOFvu396j3x+UC\n" \
"B5iPNgiV5+I3lg02dZ77DnKxHZu8A/lJBdiB3QW0KtZB6awBdpUKD9jf1b0SHzUv\n" \
"KBds0pjBqAlkd25HN7rOrFleaJ1/ctaJxQZBKT5ZPt0m9STJEadao0xAH0ahmbWn\n" \
"OlFuhjuefXKnEgV4We0+UXgVCwOPjdAvBbI+e0ocS3MFEvzG6uBQE3xDk3SzynTn\n" \
"jh8BCNAw1FtxNrQHusEwMFxIt4I7mKZ9YIqioymCzLq9gwQbooMDQaHWBfEbwrbw\n" \
"qHyGO0aoSCqI3Haadr8faqU9GY/rOPNk3sgrDQoo//fb4hVC1CLQJ13hef4Y53CI\n" \
"rU7m2Ys6xt0nUW7/vGT1M0NPAgMBAAGjQjBAMA4GA1UdDwEB/wQEAwIBBjAPBgNV\n" \
"HRMBAf8EBTADAQH/MB0GA1UdDgQWBBR5tFnme7bl5AFzgAiIyBpY9umbbjANBgkq\n" \
"hkiG9w0BAQsFAAOCAgEAVR9YqbyyqFDQDLHYGmkgJykIrGF1XIpu+ILlaS/V9lZL\n" \
"ubhzEFnTIZd+50xx+7LSYK05qAvqFyFWhfFQDlnrzuBZ6brJFe+GnY+EgPbk6ZGQ\n" \
"3BebYhtF8GaV0nxvwuo77x/Py9auJ/GpsMiu/X1+mvoiBOv/2X/qkSsisRcOj/KK\n" \
"NFtY2PwByVS5uCbMiogziUwthDyC3+6WVwW6LLv3xLfHTjuCvjHIInNzktHCgKQ5\n" \
"ORAzI4JMPJ+GslWYHb4phowim57iaztXOoJwTdwJx4nLCgdNbOhdjsnvzqvHu7Ur\n" \
"TkXWStAmzOVyyghqpZXjFaH3pO3JLF+l+/+sKAIuvtd7u+Nxe5AW0wdeRlN8NwdC\n" \
"jNPElpzVmbUq4JUagEiuTDkHzsxHpFKVK7q4+63SM1N95R1NbdWhscdCb+ZAJzVc\n" \
"oyi3B43njTOQ5yOf+1CceWxG1bQVs5ZufpsMljq4Ui0/1lvh+wjChP4kqKOJ2qxq\n" \
"4RgqsahDYVvTH9w7jXbyLeiNdd8XM2w9U/t7y0Ff/9yi0GE44Za4rF2LN9d11TPA\n" \
"mRGunUHBcnWEvgJBQl9nJEiU0Zsnvgc/ubhPgXRR4Xq37Z0j4r7g1SgEEzwxA57d\n" \
"emyPxgcYxn/eR44/KJ4EBs+lVDR3veyJm+kXQ99b21/+jh5Xos1AnX5iItreGCc=\n" \
"-----END CERTIFICATE-----\n"
```

## src/mqtt_connection.c
```c
#include <stdio.h>
#include <string.h>
#include <ncs_version.h>

#include <zephyr/logging/log.h>
#include <zephyr/kernel.h>
#include <zephyr/net/socket.h>
#include <zephyr/net/mqtt.h>
#include <nrf_modem_at.h>

#include <dk_buttons_and_leds.h>
#include "mqtt_connection.h"

#include <zephyr/random/random.h>

/* STEP 2.4 - Include the header file for the modem key management library */
#include<modem/modem_key_mgmt.h>

/* STEP 3.3 - Include certificate.h */
#include "certificate.h"

/* Buffers for MQTT client. */
static uint8_t rx_buffer[CONFIG_MQTT_MESSAGE_BUFFER_SIZE];
static uint8_t tx_buffer[CONFIG_MQTT_MESSAGE_BUFFER_SIZE];
static uint8_t payload_buf[CONFIG_MQTT_PAYLOAD_BUFFER_SIZE];

/* MQTT Broker details. */
static struct sockaddr_storage broker;

LOG_MODULE_DECLARE(MQTT_GNSS);
extern bool connected;

/**@brief Function to store the server x.509 root certificate to the modem 
 */
/* STEP 4.2 - Add the function certificate_provision() that will store the certificate to the modem.*/
int certificate_provision()
{
	int err = 0;
	bool exists;

	err = modem_key_mgmt_exists(CONFIG_MQTT_TLS_SEC_TAG, MODEM_KEY_MGMT_CRED_TYPE_CA_CHAIN, &exists);

	if(err)
	{
		LOG_ERR("Failed to check for certificates err %d\n", err);
		return err;
	}

	if(exists)
	{
		err = modem_key_mgmt_cmp(CONFIG_MQTT_TLS_SEC_TAG, MODEM_KEY_MGMT_CRED_TYPE_CA_CHAIN, CA_CERTIFICATE, strlen(CA_CERTIFICATE));
		LOG_INF("%s\n", err ? "mismatch" : "match");
		if(!err)
		{
			return 0;
		}
	}
	LOG_INF("Provisioning certificates");
	err = modem_key_mgmt_write(CONFIG_MQTT_TLS_SEC_TAG, MODEM_KEY_MGMT_CRED_TYPE_CA_CHAIN, CA_CERTIFICATE, strlen(CA_CERTIFICATE));

	if(err)
	{
		LOG_ERR("Failed to provision CA certificate: %d", err);
		return err;
	}

	return err;
}

/**@brief Function to get the payload of recived data.
 */
static int get_received_payload(struct mqtt_client *c, size_t length)
{
	int ret;
	int err = 0;

	/* Return an error if the payload is larger than the payload buffer.
	 * Note: To allow new messages, we have to read the payload before returning.
	 */
	if (length > sizeof(payload_buf)) {
		err = -EMSGSIZE;
	}

	/* Truncate payload until it fits in the payload buffer. */
	while (length > sizeof(payload_buf)) {
		ret = mqtt_read_publish_payload_blocking(
				c, payload_buf, (length - sizeof(payload_buf)));
		if (ret == 0) {
			return -EIO;
		} else if (ret < 0) {
			return ret;
		}

		length -= ret;
	}

	ret = mqtt_readall_publish_payload(c, payload_buf, length);
	if (ret) {
		return ret;
	}

	return err;
}

/**@brief Function to subscribe to the configured topic
 */
static int subscribe(struct mqtt_client *const c)
{
	struct mqtt_topic subscribe_topic = {
		.topic = {
			.utf8 = CONFIG_MQTT_SUB_TOPIC,
			.size = strlen(CONFIG_MQTT_SUB_TOPIC)
		},
		.qos = MQTT_QOS_1_AT_LEAST_ONCE
	};

	const struct mqtt_subscription_list subscription_list = {
		.list = &subscribe_topic,
		.list_count = 1,
		.message_id = 1234
	};

	LOG_INF("Subscribing to: %s len %u", CONFIG_MQTT_SUB_TOPIC,
		(unsigned int)strlen(CONFIG_MQTT_SUB_TOPIC));

	return mqtt_subscribe(c, &subscription_list);
}

/**@brief Function to print strings without null-termination
 */
static void data_print(uint8_t *prefix, uint8_t *data, size_t len)
{
	char buf[len + 1];

	memcpy(buf, data, len);
	buf[len] = 0;
	LOG_INF("%s%s", (char *)prefix, (char *)buf);
}

/**@brief Function to publish data on the configured topic
 */
int data_publish(struct mqtt_client *c, enum mqtt_qos qos,
	uint8_t *data, size_t len)
{
	struct mqtt_publish_param param;

	param.message.topic.qos = qos;
	param.message.topic.topic.utf8 = CONFIG_MQTT_PUB_TOPIC;
	param.message.topic.topic.size = strlen(CONFIG_MQTT_PUB_TOPIC);
	param.message.payload.data = data;
	param.message.payload.len = len;
	param.message_id = sys_rand32_get();
	param.dup_flag = 0;
	param.retain_flag = 0;

	data_print("Publishing: ", data, len);
	LOG_INF("to topic: %s len: %u",
		CONFIG_MQTT_PUB_TOPIC,
		(unsigned int)strlen(CONFIG_MQTT_PUB_TOPIC));

	return mqtt_publish(c, &param);
}
/**@brief MQTT client event handler
 */
void mqtt_evt_handler(struct mqtt_client *const c,
		      const struct mqtt_evt *evt)
{
	int err;

	switch (evt->type) {
	case MQTT_EVT_CONNACK:
		if (evt->result != 0) {
			LOG_ERR("MQTT connect failed: %d", evt->result);
			break;
		}

		LOG_INF("MQTT client connected");
		//subscribe(c);
		connected = true;
		break;

	case MQTT_EVT_DISCONNECT:
		LOG_INF("MQTT client disconnected: %d", evt->result);
		break;

	case MQTT_EVT_PUBLISH:
	{
		const struct mqtt_publish_param *p = &evt->param.publish;
		//Print the length of the recived message 
		LOG_INF("MQTT PUBLISH result=%d len=%d",
			evt->result, p->message.payload.len);

		//Extract the data of the recived message 
		err = get_received_payload(c, p->message.payload.len);
		
		//Send acknowledgment to the broker on receiving QoS1 publish message 
		if (p->message.topic.qos == MQTT_QOS_1_AT_LEAST_ONCE) {
			const struct mqtt_puback_param ack = {
				.message_id = p->message_id
			};

			/* Send acknowledgment. */
			mqtt_publish_qos1_ack(c, &ack);
		}
		
		//On successful extraction of data 
		if (err >= 0) {
			data_print("Received: ", payload_buf, p->message.payload.len);
			// Control the LED 
			if(strncmp(payload_buf,CONFIG_TURN_LED_ON_CMD,sizeof(CONFIG_TURN_LED_ON_CMD)-1) == 0){
				dk_set_led_on(LED_CONTROL_OVER_MQTT);
			}
			else if(strncmp(payload_buf,CONFIG_TURN_LED_OFF_CMD,sizeof(CONFIG_TURN_LED_OFF_CMD)-1) == 0){
				dk_set_led_off(LED_CONTROL_OVER_MQTT);
			}
		// On failed extraction of data - Payload buffer is smaller than the recived data . Increase 
		} else if (err == -EMSGSIZE) {
			LOG_ERR("Received payload (%d bytes) is larger than the payload buffer "
				"size (%d bytes).",
				p->message.payload.len, sizeof(payload_buf));
		//On failed extraction of data - Failed to extract data, disconnect 
		} else {
			LOG_ERR("get_received_payload failed: %d", err);
			LOG_INF("Disconnecting MQTT client...");

			err = mqtt_disconnect(c);
			if (err) {
				LOG_ERR("Could not disconnect: %d", err);
			}
		}
	} break;

	case MQTT_EVT_PUBACK:
		if (evt->result != 0) {
			LOG_ERR("MQTT PUBACK error: %d", evt->result);
			break;
		}

		LOG_INF("PUBACK packet id: %u", evt->param.puback.message_id);
		break;

	case MQTT_EVT_SUBACK:
		if (evt->result != 0) {
			LOG_ERR("MQTT SUBACK error: %d", evt->result);
			break;
		}

		LOG_INF("SUBACK packet id: %u", evt->param.suback.message_id);
		break;

	case MQTT_EVT_PINGRESP:
		if (evt->result != 0) {
			LOG_ERR("MQTT PINGRESP error: %d", evt->result);
		}
		break;

	default:
		LOG_INF("Unhandled MQTT event type: %d", evt->type);
		break;
	}
}

/**@brief Resolves the configured hostname and
 * initializes the MQTT broker structure
 */
static int broker_init(void)
{
	int err;
	struct addrinfo *result;
	struct addrinfo *addr;
	struct addrinfo hints = {
		.ai_family = AF_INET,
		.ai_socktype = SOCK_STREAM
	};

	err = getaddrinfo(CONFIG_MQTT_BROKER_HOSTNAME, NULL, &hints, &result);
	if (err) {
		LOG_ERR("getaddrinfo failed: %d", err);
		return -ECHILD;
	}

	addr = result;

	/* Look for address of the broker. */
	while (addr != NULL) {
		/* IPv4 Address. */
		if (addr->ai_addrlen == sizeof(struct sockaddr_in)) {
			struct sockaddr_in *broker4 =
				((struct sockaddr_in *)&broker);
			char ipv4_addr[NET_IPV4_ADDR_LEN];

			broker4->sin_addr.s_addr =
				((struct sockaddr_in *)addr->ai_addr)
				->sin_addr.s_addr;
			broker4->sin_family = AF_INET;
			broker4->sin_port = htons(CONFIG_MQTT_BROKER_PORT);

			inet_ntop(AF_INET, &broker4->sin_addr.s_addr,
				  ipv4_addr, sizeof(ipv4_addr));
			LOG_INF("IPv4 Address found %s", (char *)(ipv4_addr));

			memcpy(&broker, broker4, sizeof(struct sockaddr_in));

			break;
		} else {
			LOG_ERR("ai_addrlen = %u should be %u or %u",
				(unsigned int)addr->ai_addrlen,
				(unsigned int)sizeof(struct sockaddr_in),
				(unsigned int)sizeof(struct sockaddr_in6));
		}

		addr = addr->ai_next;
	}

	

	/* Free the address. */
	freeaddrinfo(result);

	return err;
}

/* Function to get the client id */
static const uint8_t* client_id_get(void)
{
	static uint8_t client_id[MAX(sizeof(CONFIG_MQTT_CLIENT_ID),
				     CLIENT_ID_LEN)];

	if (strlen(CONFIG_MQTT_CLIENT_ID) > 0) {
		snprintf(client_id, sizeof(client_id), "%s",
			 CONFIG_MQTT_CLIENT_ID);
		goto exit;
	}

	char imei_buf[CGSN_RESPONSE_LENGTH + 1];
	int err;

	err = nrf_modem_at_cmd(imei_buf, sizeof(imei_buf), "AT+CGSN");
	if (err) {
		LOG_ERR("Failed to obtain IMEI, error: %d", err);
		goto exit;
	}

	imei_buf[IMEI_LEN] = '\0';

	snprintf(client_id, sizeof(client_id), "nrf-%.*s", IMEI_LEN, imei_buf);

exit:
	LOG_DBG("client_id = %s", (char *)(client_id));
	LOG_INF("client_id = %s", (char *)(client_id));

	return client_id;
}


/**@brief Initialize the MQTT client structure
 */
int client_init(struct mqtt_client *client)
{
	int err;
	static struct mqtt_utf8 password;
	static struct mqtt_utf8 username;
	/* Initializes the client instance. */
	mqtt_client_init(client);

	/* Resolves the configured hostname and initializes the MQTT broker structure */
	err = broker_init();
	if (err) {
		LOG_ERR("Failed to initialize broker connection");
		return err;
	}

	/* MQTT client configuration */
	client->broker = &broker;
	client->evt_cb = mqtt_evt_handler;
	client->client_id.utf8 = client_id_get();
	client->client_id.size = strlen(client->client_id.utf8);

	username.utf8 = CONFIG_MQTT_USERNAME;
	username.size = sizeof(CONFIG_MQTT_USERNAME) - 1;

	client->user_name = &username;

	password.utf8 = CONFIG_MQTT_PASSWORD;
	password.size = sizeof(CONFIG_MQTT_PASSWORD) - 1;

	client->password = &password;
	
	client->protocol_version = MQTT_VERSION_3_1_1;

	/* MQTT buffers configuration */
	client->rx_buf = rx_buffer;
	client->rx_buf_size = sizeof(rx_buffer);
	client->tx_buf = tx_buffer;
	client->tx_buf_size = sizeof(tx_buffer);

	/* STEP 5 - Modify the client client_init() function to use Secure TCP transport instead of non-secure TCP transport.  */
	struct mqtt_sec_config *tls_cfg = &(client->transport).tls.config;
	static sec_tag_t sec_tag_list[] = {CONFIG_MQTT_TLS_SEC_TAG};

	LOG_INF("TLS enabled");
	client->transport.type = MQTT_TRANSPORT_SECURE;

	tls_cfg->peer_verify = CONFIG_MQTT_TLS_PEER_VERIFY;
	tls_cfg->cipher_list = NULL;
	tls_cfg->cipher_count = 0;
	tls_cfg->sec_tag_count = ARRAY_SIZE(sec_tag_list);
	tls_cfg->sec_tag_list = sec_tag_list;
	tls_cfg->hostname = CONFIG_MQTT_BROKER_HOSTNAME;

	tls_cfg->session_cache = IS_ENABLED(CONFIG_MQTT_TLS_SESSION_CACHING) ? TLS_SESSION_CACHE_ENABLED : TLS_SESSION_CACHE_DISABLED;

	return err;
}

/**@brief Initialize the file descriptor structure used by poll.
 */
int fds_init(struct mqtt_client *c, struct pollfd *fds)
{
	if (c->transport.type == MQTT_TRANSPORT_NON_SECURE) {
		fds->fd = c->transport.tcp.sock;
	} else {
		/* STEP 6 - Update the file descriptor for the socket to use TLS socket instead of a plain TCP socket.*/
		//return -ENOTSUP;
		fds->fd = c->transport.tls.sock;
	}

	fds->events = POLLIN;

	return 0;
}
```
